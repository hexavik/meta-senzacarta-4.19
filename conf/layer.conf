## conf/layer.conf
```bitbake
# We have a conf and classes directory, add to BBPATH
BBPATH .= ":${LAYERDIR}"

# We have recipes-* directories, add to BBFILES
BBFILES += "${LAYERDIR}/recipes-*/*/*.bb \
            ${LAYERDIR}/recipes-*/*/*.bbappend"

BBFILE_COLLECTIONS += "meta-senzacarta"
BBFILE_PATTERN_meta-senzacarta = "^${LAYERDIR}/"
BBFILE_PRIORITY_meta-senzacarta = "6"

LAYERDEPENDS_meta-senzacarta = "core"
LAYERSERIES_COMPAT_meta-senzacarta = "warrior"

# Add the Freescale license
FSL_EULA_FILE = ${LAYERDIR}/EULA.txt

DISTRO_FEATURES_append = " optee"
```

## conf/machine/imx7dsenzacarta.conf
```bitbake
#@TYPE: Machine
#@NAME: i.MX7D SenzaCarta V1
#@SOC: i.MX7D
#@DESCRIPTION: Machine configuration for i.MX7D SenzaCarta
#@MAINTAINER: Vikrant A .P. <vikrant.ap@econote.in>

MACHINEOVERRIDES =. "mx7:mx7d:"

require conf/machine/include/imx-base.inc
require conf/machine/include/tune-cortexa7.inc

MACHINE_FEATURES += " epdc wifi bluetooth optee bcm4339"

PREFERRED_PROVIDER_u-boot_mx7 = "u-boot-senzacarta"
PREFERRED_PROVIDER_virtual/bootloader_mx7 = "u-boot-senzacarta"
PREFERRED_PROVIDER_virtual/kernel_mx7 = "linux-senzacarta"
PREFERRED_VERSION_linux-senzcarta ?= "4.19"

KERNEL_DEVICETREE = "imx7d-sdb.dtb"

#UBOOT_CONFIG ??= "${@bb.utils.contains('COMBINED_FEATURES', 'optee', 'sd-optee', 'sd', d)}"
UBOOT_CONFIG ??= "sd"
UBOOT_CONFIG[sd] = "mx7dsenzacarta_config,sdcard"
#UBOOT_CONFIG[epdc] = "mx7dsabresd_epdc_config"
#UBOOT_CONFIG[mfgtool] = "mx7dsabresd_config"
#UBOOT_CONFIG[sd-optee] = "mx7dsabresd_optee_config,sdcard"

OPTEE_BIN_EXT = "7dsdb"

XSERVER += "mesa-driver-swrast"

MACHINE_EXTRA_FEATURES += "firmware-imx-brcm"
```
